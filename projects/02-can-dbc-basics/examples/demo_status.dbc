VERSION ""

NS_ :

BS_:

BU_: SimECU SimVCU

BO_ 801 DemoStatus: 1 SimECU
 SG_ ReadySt : 0|8@1+ (1,0) [0|1] "" SimVCU

CM_ "Fictional original teaching data only. Not a real vehicle protocol.";
VAL_ 801 ReadySt 0 "未就绪" 1 "已就绪" ;
